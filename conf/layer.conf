## conf/layer.conf
```bitbake
# Board specific layer configuration for meta-mender
# Copyright 2018 TeamRed Security Inc.

# We have a conf and classes directory, add to BBPATH
BBPATH .= ":${LAYERDIR}"

# We have recipes-* directories, add to BBFILES
BBFILES += "${LAYERDIR}/recipes-*/*/*.bb \
    ${LAYERDIR}/recipes-*/*/*.bbappend \
    ${LAYERDIR}/classes/*.bbclass \
"

BBFILE_COLLECTIONS += "mender-espressobin"
BBFILE_PATTERN_mender-espressobin = "^${LAYERDIR}/"
BBFILE_PRIORITY_mender-espressobin = "10"
```
